## package/kalray/dma-firmware/Config.in
```kconfig
config BR2_PACKAGE_DMA_FIRMWARE
	bool "dma-firmware"
	depends on BR2_kvx
	depends on BR2_LINUX_KERNEL
	help
		Coolidge DMA firmware

config BR2_DMA_FIRMWARE_VERSION
	string
```

## package/kalray/odp/Config.in
```kconfig
config BR2_PACKAGE_ODP
	bool "KVX ODP"
	depends on BR2_kvx
	depends on BR2_PACKAGE_MPPA_HELPER_LIBS
	depends on BR2_PACKAGE_MPPA_RPROC
	depends on BR2_PACKAGE_KALRAY_MAKEFILE
	help
		Open Data Plane library and headers installed in stage
config BR2_ODP_FPGA
	bool "KVX ODP FPGA flavour"
	default n
	depends on BR2_PACKAGE_ODP
	help
		configuration for FPGA setup

config BR2_ODP_TESTSUITE
	bool "KVX ODP testsuite"
	default n
	depends on BR2_PACKAGE_ODP
	help
		Install Open Data Plane testsuite in target

config BR2_PACKAGE_KVX_ODP_NOTIF
	bool "KVX ODP notification module"
	default y
	depends on BR2_LINUX_KERNEL
	help
	  Kernel module to send notifications to ODP.

config BR2_PACKAGE_KVX_VIRTIONET_MQ
	bool "kvx virtionet multiqueue module"
	default n
	depends on BR2_LINUX_KERNEL
	help
	  Kernel module to support kvx virtionet device.

config BR2_ODP_SYSCALL_SUPPORT
	bool "KVX ODP SYSCALL SUPORT"
	default n
	depends on BR2_PACKAGE_ODP
	help
		Enable Open Data Plane syscall support

config BR2_ODP_VERSION
	string
```

## package/kalray/phy-eth-firmware/Config.in
```kconfig
config BR2_PACKAGE_PHY_ETH_FIRMWARE
	bool "phy-eth-firmware"
	depends on BR2_kvx
	depends on BR2_LINUX_KERNEL
	help
		Coolidge Linux phy eth firmware

config BR2_PHY_ETH_FIRMWARE_VERSION
	string
```
