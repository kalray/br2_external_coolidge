## package/kalray/rauc/Config.in
```kconfig
config BR2_RAUC_CUSTOM_TARBALL
	bool "Use custom RAUC tarball"
	depends on BR2_PACKAGE_RAUC
	help
	  This option allows to specify a URL pointing to a rauc
	  source tarball. This URL can use any protocol recognized by
	  Buildroot, like http://, ftp://, file:// or scp://.

	  When pointing to a local tarball using file://, you may want
	  to use a make variable like $(TOPDIR) to reference the root of
	  the Buildroot tree.

config BR2_RAUC_CUSTOM_TARBALL_LOCATION
	string "URL of custom rauc tarball"
	depends on BR2_RAUC_CUSTOM_TARBALL
```

## projects/kvx_odp_notif/Kconfig
```kconfig
config KVX_ODP_NOTIF
	tristate "KVX ODP notification driver"
	depends on KVX
	default m
	help
		Enable this driver to notify ODP of various information on
		CoS clusters.
```
