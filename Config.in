## Config.in
```kconfig
config BR2_KALRAY_TOOLCHAIN_DIR
	string "path to the Kalray toolchain"
	help
		Some packages build binaries and libraries with ClusterOS target.
		In general, they are based on Makefile.kalray.
		Makefile.kalray relies on KALRAY_TOOLCHAIN_DIR to find everything
		it needs in the toolchain. It does have have to be added in PATH.


source "$BR2_EXTERNAL_KVX_PATH/package/kalray/kvx-firmware/Config.in"
source "$BR2_EXTERNAL_KVX_PATH/package/kalray/qperf/Config.in"
source "$BR2_EXTERNAL_KVX_PATH/package/kalray/mppa-rproc/Config.in"
source "$BR2_EXTERNAL_KVX_PATH/package/kalray/offload-daemon/Config.in"
source "$BR2_EXTERNAL_KVX_PATH/package/kalray/mppa-offload/Config.in"
source "$BR2_EXTERNAL_KVX_PATH/package/kalray/pocl/Config.in"
source "$BR2_EXTERNAL_KVX_PATH/package/kalray/pocl-firmware/Config.in"
source "$BR2_EXTERNAL_KVX_PATH/package/kalray/kalray-linux-utils/Config.in"
source "$BR2_EXTERNAL_KVX_PATH/package/kalray/kvx-odp-notif/Config.in"
```

## board/kalray/common/kernel.its
```
/dts-v1/;

/ {
	description = "Kernel images";
	#address-cells = <1>;

	images {
		kernel {
			description = "Kernel";
			data = /incbin/("KERNEL_IMAGE");
			type = "kernel";
			os = "linux";
			arch = "kvx";
			compression = "none";
			hash@1 {
				algo = "md5";
			};
		};
	};

	configurations {
		default = "default_conf";
		default_conf {
			description = "Kernel image";
			kernel = "kernel";
		};
	};
};
```

## package/kalray/bm_ruby/Config.in
```kconfig
config BR2_PACKAGE_BM_RUBY
	bool "bm_ruby"
	depends on BR2_kvx
	depends on BR2_PACKAGE_RUBY
	depends on BR2_PACKAGE_LIBMPPABM
	help
		Ruby bindings for MPPA Board management
```

## package/kalray/board_mgmt/Config.in
```kconfig
config BR2_PACKAGE_BOARD_MGMT
	bool "board_mgmt"
	depends on BR2_kvx
	depends on BR2_PACKAGE_LIBMPPABM
	depends on BR2_PACKAGE_BM_RUBY
	depends on BR2_PACKAGE_NCURSES
	depends on BR2_PACKAGE_READLINE
	help
		Board management tools for MPPA

config BR2_BOARD_MGMT_VERSION
	string
```

## package/kalray/coolval/Config.in
```kconfig
config BR2_PACKAGE_COOLVAL
	bool "coolval"
	depends on BR2_USE_MMU
	help
		Coolidge Linux port validation tool
```

## package/kalray/k1c-firmware/Config.in
```kconfig
config BR2_PACKAGE_K1C_FIRMWARE
	bool "k1c_firmware"
	depends on BR2_k1
	help
		Coolidge Linux firmware

config BR2_K1C_FIRMWARE_CUSTOM_TARBALL
	bool "Custom k1c firmware tarball"
	depends on BR2_PACKAGE_K1C_FIRMWARE
	help
	  This option allows to specify a URL pointing to a k1c firmware
	  source tarball. This URL can use any protocol recognized by
	  Buildroot, like http://, ftp://, file:// or scp://.

	  When pointing to a local tarball using file://, you may want
	  to use a make variable like $(TOPDIR) to reference the root of
	  the Buildroot tree.

config BR2_K1C_FIRMWARE_CUSTOM_TARBALL_LOCATION
	string "URL of custom k1c firmware tarball"
	depends on BR2_K1C_FIRMWARE_CUSTOM_TARBALL
```

## package/kalray/kalrauc/Config.in.host
```kconfig
config BR2_PACKAGE_HOST_KALRAUC
	bool "host kalrauc"
	select BR2_PACKAGE_HOST_SQUASHFS # run-time dependency
	help
	  KALRAUC is the custom Kalray package for the
	  Robust Auto-Update Controller developed by Pengutronix,
	  Enable this option to build the rauc
	  host tool which may be used to generate firmware
	  bundles that are handled by the target service.

	  http://rauc.io/
```

## package/kalray/kalray-linux-utils/Config.in
```kconfig
config BR2_PACKAGE_KALRAY_LINUX_UTILS
	bool "kalray-linux-utils"
	depends on BR2_kvx
	depends on BR2_PACKAGE_KALRAY_MAKEFILE
	select BR2_PACKAGE_DTC
	help
	  Kalray Linux utilitary tools. This contains various
	  scripts and binaries for kalray platforms.
```

## package/kalray/kalray-makefile/Config.in
```kconfig
config BR2_PACKAGE_KALRAY_MAKEFILE
	bool "kalray-makefile"
	depends on BR2_kvx
	help
	  The Kalray Makefile needed by various other Kalray packages.

config BR2_KALRAY_MAKEFILE_VERSION
	string
```

## package/kalray/kvx-firmware/Config.in
```kconfig
config BR2_PACKAGE_KVX_FIRMWARE
	bool "kvx_firmware"
	depends on BR2_kvx
	help
		Coolidge Linux firmware

config BR2_KVX_FIRMWARE_CUSTOM_TARBALL
	bool "Custom kvx firmware tarball"
	depends on BR2_PACKAGE_KVX_FIRMWARE
	help
	  This option allows to specify a URL pointing to a kvx firmware
	  source tarball. This URL can use any protocol recognized by
	  Buildroot, like http://, ftp://, file:// or scp://.

	  When pointing to a local tarball using file://, you may want
	  to use a make variable like $(TOPDIR) to reference the root of
	  the Buildroot tree.

config BR2_KVX_FIRMWARE_CUSTOM_TARBALL_LOCATION
	string "URL of custom kvx firmware tarball"
	depends on BR2_KVX_FIRMWARE_CUSTOM_TARBALL
```

## package/kalray/kvx-odp-notif/Config.in
```kconfig
config BR2_PACKAGE_KVX_ODP_NOTIF
	bool "KVX ODP notification module"
	depends on BR2_LINUX_KERNEL
	help
	  Kernel module to send notifications to ODP.

comment "KVX ODP notification module"
```

## package/kalray/l2-firmware/Config.in
```kconfig
config BR2_PACKAGE_L2_FIRMWARE
	bool "l2-firmware"
	depends on BR2_kvx
	depends on BR2_LINUX_KERNEL
	help
		Coolidge Linux L2 cache firmware

config BR2_L2_FIRMWARE_COMPILE_FROM_SOURCE
	bool "Compile L2 firmware from source"
	depends on BR2_PACKAGE_L2_FIRMWARE
	help
	  This option allows to compile the L2 firmware from source.

config BR2_L2_FIRMWARE_CUSTOM_TARBALL
	bool "Custom kvx l2 cache firmware tarball"
	depends on BR2_PACKAGE_L2_FIRMWARE
	help
	  This option allows to specify a URL pointing to a kvx l2 cache
	  firmware source tarball. This URL can use any protocol recognized by
	  Buildroot, like http://, ftp://, file:// or scp://.

	  When pointing to a local tarball using file://, you may want
	  to use a make variable like $(TOPDIR) to reference the root of
	  the Buildroot tree.

config BR2_L2_FIRMWARE_CUSTOM_TARBALL_LOCATION
	string "URL of custom kvx l2 cache firmware tarball"
	depends on BR2_L2_FIRMWARE_CUSTOM_TARBALL
```

## package/kalray/l2_firmware/Config.in
```kconfig
config BR2_PACKAGE_L2_FIRMWARE
	bool "l2_firmware"
	depends on BR2_k1
	help
		Coolidge L2 firmware
```

## package/kalray/libbmccom/Config.in
```kconfig
config BR2_PACKAGE_LIBBMCCOM
	bool "libbmccom"
	depends on BR2_kvx
	help
		BMC Communication library

config BR2_LIBBMCCOM_VERSION
	string
```

## package/kalray/libmppabm/Config.in
```kconfig
config BR2_PACKAGE_LIBMPPABM
	bool "libmppabm"
	depends on BR2_kvx
	depends on BR2_PACKAGE_HAS_UDEV
	help
		MPPA Board management library

config BR2_LIBMPPABM_CUSTOM_TARBALL
	bool "Custom libmppabm tarball"
	depends on BR2_PACKAGE_LIBMPPABM
	help
	  This option allows to specify a URL pointing to a kvx firmware
	  source tarball. This URL can use any protocol recognized by
	  Buildroot, like http://, ftp://, file:// or scp://.

	  When pointing to a local tarball using file://, you may want
	  to use a make variable like $(TOPDIR) to reference the root of
	  the Buildroot tree.

config BR2_LIBMPPABM_CUSTOM_TARBALL_LOCATION
	string "URL of custom libmppabm tarball"
	depends on BR2_LIBMPPABM_CUSTOM_TARBALL
```

## package/kalray/machine_headers/Config.in
```kconfig
config BR2_PACKAGE_MACHINE_HEADERS
	bool "machine headers"
	depends on BR2_kvx
	help
		Machine headers for MPPA platform devices.

config BR2_MACHINE_HEADERS_VERSION
	string
```

## package/kalray/mppa-dma/Config.in
```kconfig
config BR2_PACKAGE_MPPA_DMA
	bool "mppa-dma"
	depends on BR2_kvx
	depends on BR2_PACKAGE_MACHINE_HEADERS
	depends on BR2_PACKAGE_KALRAY_MAKEFILE
	help
		MPPA dma library

config BR2_MPPA_DMA_VERSION
	string
```

## package/kalray/mppa-helper-libs/Config.in
```kconfig
config BR2_PACKAGE_MPPA_HELPER_LIBS
	bool "MPPA helper libs"
	depends on BR2_kvx
	depends on BR2_PACKAGE_MPPA_RPROC
	depends on BR2_PACKAGE_KALRAY_MAKEFILE
	help
		MPPA helper libraries and headers installed in stage

config BR2_MPPA_HELPER_LIBS_VERSION
	string

config BR2_PACKAGE_MPPA_SHMEM_KERNEL
	bool "MPPA shmem Linux kernel module"
	default n
	depends on BR2_LINUX_KERNEL
	select BR2_PACKAGE_MPPA_SHMEM
	help
	  Kernel module to manage MPPA shared memories.

config BR2_MPPA_LOAD_MONITOR
	bool "MPPA load monitor application"
	depends on BR2_PACKAGE_NCURSES
	help
	  Tool allowing to dump the loads of the datapath clusters from Linux userspace.

config BR2_MPPA_PROFILER
	bool "MPPA profiler application"
	help
	  Tool allowing to control the profiling of the datapath cpus from Linux userspace.

config BR2_MPPA_LINK_MONITOR
	bool "MPPA link monitor application"
	help
	  Tool allowing to monitor the status of each ethernet link from Linux userspace.
```

## package/kalray/mppa-offload/Config.in
```kconfig
config BR2_PACKAGE_MPPA_OFFLOAD
	bool "mppa-offload"
	depends on BR2_kvx
	depends on BR2_PACKAGE_KALRAY_MAKEFILE
	select BR2_PACKAGE_OFFLOAD_DAEMON
	select BR2_PACKAGE_MPPA_RPROC
	help
		MPPA offload library
```

## package/kalray/mppa-rproc/Config.in
```kconfig
config BR2_PACKAGE_MPPA_RPROC
	bool "mppa-rproc"
	depends on BR2_kvx
	depends on BR2_PACKAGE_KALRAY_MAKEFILE
	help
		MPPA rproc library
```

## package/kalray/nvmem/Config.in
```kconfig
config BR2_PACKAGE_NVMEM
	bool "nvmem"
	help
	  nvmem utility that can read and dump content from otp

config BR2_NVMEM_VERSION
	string
```

## package/kalray/offload-daemon/Config.in
```kconfig
config BR2_PACKAGE_OFFLOAD_DAEMON
	bool "offload-daemon"
	depends on BR2_kvx
	depends on BR2_PACKAGE_KALRAY_MAKEFILE
	select BR2_PACKAGE_MPPA_RPROC
	select BR2_PACKAGE_LIBEVENT
	select BR2_PACKAGE_LIBDAEMON
	select BR2_PACKAGE_JSON_C
	help
		Offload daemon for mppa-offload
```

## package/kalray/pocl-firmware/Config.in
```kconfig
config BR2_PACKAGE_POCL_FIRMWARE
	bool "pocl firmwares"
	depends on BR2_kvx
	help
		Coolidge POCL firmwares for OpenCL

config BR2_PACKAGE_POCL_FIRMWARE_LIST
	string "Firmware list to be copied in final image"
	depends on BR2_PACKAGE_POCL_FIRMWARE
	help
		Space separated list of firmwares to be copied to the final
		image. if empty, all firmwares will be copied.

config BR2_POCL_FIRMWARE_CUSTOM_TARBALL
	bool "Custom kvx firmware tarball"
	depends on BR2_PACKAGE_POCL_FIRMWARE
	help
	  This option allows to specify a URL pointing to a pocl firmware
	  source tarball. This URL can use any protocol recognized by
	  Buildroot, like http://, ftp://, file:// or scp://.

	  When pointing to a local tarball using file://, you may want
	  to use a make variable like $(TOPDIR) to reference the root of
	  the Buildroot tree.

config BR2_POCL_FIRMWARE_CUSTOM_TARBALL_LOCATION
	string "URL of custom kvx firmware tarball"
	depends on BR2_POCL_FIRMWARE_CUSTOM_TARBALL
```

## package/kalray/pocl/Config.in
```kconfig
config BR2_PACKAGE_POCL
	bool "pocl"
	depends on BR2_kvx
	select BR2_PACKAGE_MESA3D_HEADERS
	select BR2_PACKAGE_HAS_LIBOPENCL
	help
		POCL library

config BR2_PACKAGE_PROVIDES_LIBOPENCL
	default "pocl" if BR2_PACKAGE_POCL

config BR2_POCL_VERSION
	string
```
